&zmk {
    // Bluetooth configuration
    bt {
        device-name = "ZMK Keyboard";  // Custom name for your keyboard
        passkey = "123456";            // Temporary passkey for pairing
    };
};
